## drivers/media/i2c/Kconfig
```kconfig
config VIDEO_ISX031
	tristate "ISX031 sensor support"
	depends on VIDEO_DEV && I2C
	select VIDEO_V4L2_SUBDEV_API
	depends on MEDIA_CAMERA_SUPPORT
	help
	  This is a Video4Linux2 sensor-level driver for
          Sony ISX031 camera with a MIPI CSI-2 interface.

          To compile this driver as a module, choose M here: the
          module will be called isx031.

config VIDEO_MAX9X
	tristate "MAX9X serdes support"
	depends on VIDEO_DEV && I2C
	select VIDEO_V4L2_SUBDEV_API
	depends on MEDIA_CAMERA_SUPPORT
	help
	  This is a Video4Linux2 sensor-level driver for MAX9X serdes.

config VIDEO_AR0234
	tristate "ON Semiconductor AR0234 sensor support"
	depends on VIDEO_DEV && I2C
	select VIDEO_V4L2_SUBDEV_API
	depends on MEDIA_CAMERA_SUPPORT
	help
	  This is a Video4Linux2 sensor driver for the ON Semiconductor
	  AR0234 camera.

	  To compile this driver as a module, choose M here: the
	  module will be called ar0234.

config VIDEO_LT6911UXC
	tristate "Lontium LT6911UXC decoder"
	depends on VIDEO_DEV && I2C
	select VIDEO_V4L2_SUBDEV_API
	help
	  This is a Video4Linux2 sensor-level driver for the Lontium
	  LT6911UXC HDMI to MIPI CSI-2 bridge.

	  To compile this driver as a module, choose M here: the
	  module will be called lt6911uxc.

config VIDEO_LT6911UXE
	tristate "Lontium LT6911UXE decoder"
	depends on VIDEO_DEV && I2C
	select VIDEO_V4L2_SUBDEV_API
	help
	  This is a Video4Linux2 sensor-level driver for the Lontium
	  LT6911UXE HDMI to MIPI CSI-2 bridge.

	  To compile this driver as a module, choose M here: the
	  module will be called lt6911uxe.
```

## drivers/media/platform/intel/Kconfig
```kconfig
config INTEL_IPU6_ACPI
	tristate "Enable IPU ACPI driver"
	depends on I2C
	depends on ACPI
	depends on INTEL_SKL_INT3472
	help
	Driver to read ACPI data from BIOS

	This driver is used to read ACPI data from BIOS
```

## vied-viedlin-intel-next/drivers/media/platform/intel/Kconfig
```kconfig
config INTEL_IPU6_FPGA_PDATA
	bool "Enable built in platform data for ipu6 fpga"
	depends on VIDEO_INTEL_IPU6
	help
	Pre-ACPI system platform data is compiled inside kernel

config INTEL_IPU6_TGLRVP_PDATA
	bool "Enable built in platform data for TGL RVP"
	depends on VIDEO_INTEL_IPU6
	help
	Pre-ACPI system platform data is compiled inside kernel

config INTEL_IPU6_JSLRVP_PDATA
	bool "Enable built in platform data for JSL RVP"
	depends on MEDIA_CAMERA_SUPPORT
	help
	 Pre-ACPI system platform data is compiled inside kernel

config INTEL_IPU6_ADLRVP_PDATA
	bool "Enable built in platform data for ADL RVP"
	depends on MEDIA_CAMERA_SUPPORT
	help
	 Pre-ACPI system platform data is compiled inside kernel

	 This platform data is useful for software development before
	 the SOC system not ready.

config INTEL_IPU6_OV2775
	bool "Compile platform data for OV2775"
	depends on INTEL_IPU6_FPGA_PDATA
	help
	"Omnivision OV2775 camera sensor"

config INTEL_IPU6_ACPI
	bool "Enable IPU ACPI driver"
	depends on VIDEO_INTEL_IPU6
	help
	Driver to read ACPI data from BIOS

	This driver is used to read ACPI data from BIOS
```
